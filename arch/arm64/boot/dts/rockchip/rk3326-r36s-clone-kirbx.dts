// SPDX-License-Identifier: (GPL-2.0+ OR MIT)
/*
 * EXPERIMENTAL - not tested on hardware by andr36oid. Keep a copy of the files
 * you replace so you can go back.
 *
 * R36S clone "KirbX", board print Y3506_V03_20250317 (clone issue #4).
 *
 * This is a Soy Sauce board: the stock DTB for this board print in dArkOSen
 * and dArkOSRE (soysauce/Y3506_V03_20250317) and the reporter's booting
 * device tree all have the Soy Sauce wiring (PMIC interrupt GPIO0_A7,
 * charger detect GPIO3_C7, SD rails, stick mux and button pins). The panel
 * is the Soy Sauce "Panel 6" one, so take that file as it is.
 */

#include "rk3326-r36s-clone-soysauce-panel6.dts"

/ {
	model = "R36S clone KirbX, Y3506_V03 (experimental)";
};

/*
 * This board freezes/bootloops when a card is in the second SD slot (clone
 * issue #4). Turn the slot off so the console boots regardless of what is
 * in slot 2. GPIO0_B2 is that slot's card detect on this board.
 */
&sdio {
	status = "disabled";
};
