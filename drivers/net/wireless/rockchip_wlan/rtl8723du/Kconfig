## drivers/net/wireless/rockchip_wlan/rtl8723du/Kconfig
```kconfig
config RTL8723DU
	tristate "Realtek RTL8723DU USB Wi-Fi"
	depends on USB && CFG80211 && m
	help
	  Build the vendor RTL8723DU driver as the 8723du module.
```

## drivers/net/wireless/rockchip_wlan/rtl8852au/Kconfig
```kconfig
config RTL8852AU
	tristate "Realtek 8852A USB WiFi"
	depends on USB && CFG80211 && m
	help
	  Help message of RTL8852AU
```

## drivers/net/wireless/rockchip_wlan/rtl8852cu/Kconfig
```kconfig
config RTL8852CU
	tristate "Realtek 8852C USB WiFi"
	depends on USB && CFG80211 && m
	help
	  Help message of RTL8852CU
```

## drivers/net/wireless/rockchip_wlan/rtw88_usb/Kconfig
```kconfig
config ANDR36OID_RTW88_USB
	tristate "Realtek RTL8822CU USB backport"
	depends on USB && MAC80211 && m
	select WANT_DEV_COREDUMP
	help
	  Build the isolated USB backport for RTL8822CU. Exported symbols
	  carry an a36_rtw88usb_ prefix so native rtw88 may coexist.
```
